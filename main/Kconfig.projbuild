## main/Kconfig.projbuild
```kconfig
menu "mibee-cam Configuration"

    config MIBEE_CAM_ENABLE_MOTION
        bool "Enable motion detection"
        default y
        help
            Enable frame-difference motion detection.

    config MIBEE_CAM_ENABLE_NAS
        bool "Enable NAS upload (FTP/WebDAV/HTTP)"
        default y
        help
            Enable file upload to NAS server via FTP, WebDAV, or HTTP POST.

    config MIBEE_CAM_ENABLE_HEALTH
        bool "Enable health monitoring"
        default y
        help
            Enable periodic health monitoring with Prometheus /metrics endpoint.

    config MIBEE_CAM_DEFAULT_XCLK_MHZ
        int "Default camera XCLK frequency (MHz)"
        default 20
        help
            Master clock frequency for the camera sensor.
            20 MHz is standard for genuine OV2640.
            Use 10 MHz for unstable clone modules (fixes NO-SOI / white image).
            The user can override at runtime via web UI.

endmenu

menu "mibee-cam CSI Motion Sensing (ESPectre)"

    config MIBEE_CSI_MOTION
        bool "Enable ESPectre WiFi CSI motion sensing"
        default n
        select ESP_WIFI_CSI_ENABLED if SOC_WIFI_CSI_SUPPORT
        help
            Embed the ESPectre sensing runtime (components/espectre, GPLv3)
            and start it after WiFi init. Logs motion-state changes only —
            no API/contract surface yet (family pilot, 2026-09-06). Detection
            profile / CSI cadence are tuned under "ESPectre Sensing".
            With this option off the firmware is byte-identical to the
            pre-ESPectre baseline (verified on seeed 2026-09-06).
            NOTE: classic ESP32 is listed as supported upstream but has no
            published benchmarks — treat this board as experimental.

endmenu
```
