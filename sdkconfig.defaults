## sdkconfig.defaults
```kconfig
# CPU
CONFIG_ESP_DEFAULT_CPU_FREQ_MHZ_240=y
CONFIG_ESP_DEFAULT_CPU_FREQ_MHZ=240

# PSRAM (REQUIRED for camera frame buffers)
CONFIG_SPIRAM=y
CONFIG_SPIRAM_BOOT_INIT=y
CONFIG_SPIRAM_USE_MALLOC=y
CONFIG_SPIRAM_MALLOC_ALWAYSINTERNAL=16384

# Camera - PSRAM DMA disabled for ESP32 (not S2/S3)
# DMA-capable PSRAM allocation fails on original ESP32
CONFIG_CAMERA_PSRAM_DMA=n

# SCCB - Use legacy I2C driver (new driver fails writes on OV2640)
# See: https://github.com/espressif/esp32-camera/issues/743
CONFIG_SCCB_HARDWARE_I2C_DRIVER_LEGACY=y

# Flash 4MB
CONFIG_ESPTOOLPY_FLASHSIZE_4MB=y
CONFIG_ESPTOOLPY_FLASHSIZE="4MB"

# Partition table
CONFIG_PARTITION_TABLE_CUSTOM=y
CONFIG_PARTITION_TABLE_CUSTOM_FILENAME="partitions.csv"

# HTTP Server
CONFIG_HTTPD_MAX_REQ_HDR_LEN=2048
CONFIG_HTTPD_MAX_URI_LEN=1024

# Main task stack
CONFIG_ESP_MAIN_TASK_STACK_SIZE=8192

# Task Watchdog
CONFIG_ESP_TASK_WDT_INIT=y
CONFIG_ESP_TASK_WDT_TIMEOUT_S=30

# Log
CONFIG_LOG_DEFAULT_LEVEL_INFO=y
CONFIG_LOG_DEFAULT_LEVEL=3
CONFIG_LOG_COLORS=y


# FreeRTOS
CONFIG_FREERTOS_HZ=1000
CONFIG_FREERTOS_MAX_TASK_NAME_LEN=16
# Move FreeRTOS functions from IRAM to flash (saves ~10KB IRAM)
CONFIG_FREERTOS_PLACE_FUNCTIONS_IN_FLASH=y

# Optimization - reduce code size to fit IRAM
CONFIG_COMPILER_OPTIMIZATION_SIZE=y

# Disable core dump (saves IRAM)
CONFIG_ESP32_COREDUMP=n

# Disable debug features to reduce IRAM usage
CONFIG_ESP32_DEBUG_OCDAWARE=n

# WebSocket support (for real-time push to browser)
CONFIG_HTTPD_WS_SUPPORT=y

# WiFi PHY - force full RF calibration every boot
# Board RF link is marginal (distance + antenna); stored partial calibration is unreliable.
# See: esp_phy/Kconfig ESP_PHY_CALIBRATION_AND_DATA_STORAGE help (case 2)
CONFIG_ESP_PHY_RF_CAL_FULL=y
CONFIG_ESP_PHY_CALIBRATION_AND_DATA_STORAGE=n

# Increase esp_timer task stack (default 3584 too small — stack overflow on WiFi reconnect stress)
CONFIG_ESP_TIMER_TASK_STACK_SIZE=6144

# TCP/lwIP tuning for marginal WiFi (high packet loss, high jitter)
# TCP/lwIP tuning for marginal WiFi (high RTT ~1s, high jitter)
# Larger send buffer + window: 23040 / 760 MSS = ~30 segments in flight
# Theoretical throughput: 23040 / 1s RTT = ~23 KB/s (enough for 20KB JPEGs in <1s)
CONFIG_LWIP_TCP_SND_BUF_DEFAULT=23040
CONFIG_LWIP_TCP_WND_DEFAULT=23040
# Faster retransmission: initial RTO 300ms (default 1500ms is 5x too slow)
CONFIG_LWIP_TCP_RTO_TIME=300
# Smaller MSS for lossy WiFi: shorter air time per frame = lower PER
CONFIG_LWIP_TCP_MSS=760
# More receive mailbox slots for out-of-order segment handling
CONFIG_LWIP_TCP_RECVMBOX_SIZE=12
# Reduce max retransmissions (default 12 ≈ 20min hang, 6 ≈ 19s max)
CONFIG_LWIP_TCP_MAXRTX=6
```
